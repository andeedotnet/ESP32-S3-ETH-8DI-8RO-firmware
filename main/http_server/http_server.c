#include "http_server/http_server.h"
#include "relay/relay.h"
#include "digital_input/digital_input.h"
#include "wifi/wifi_manager.h"
#include "nvs_config/nvs_config.h"
#include "ntp/ntp.h"
#include "app_state.h"
#include "board_config.h"
#include "esp_log.h"
#include "esp_http_server.h"
#include "cJSON.h"
#include "freertos/FreeRTOS.h"
#include "freertos/semphr.h"
#include <string.h>
#include <stdlib.h>
#include <stdio.h>
#include <time.h>
#include "esp_sntp.h"

static const char *TAG = "http";

/* Symbols generated by target_add_binary_data() — filename only, not path */
extern const uint8_t index_html_start[]    asm("_binary_index_html_start");
extern const uint8_t index_html_end[]      asm("_binary_index_html_end");
extern const uint8_t bootstrap_css_start[] asm("_binary_bootstrap_min_css_start");
extern const uint8_t bootstrap_css_end[]   asm("_binary_bootstrap_min_css_end");
extern const uint8_t bootstrap_js_start[]  asm("_binary_bootstrap_min_js_start");
extern const uint8_t bootstrap_js_end[]    asm("_binary_bootstrap_min_js_end");
extern const uint8_t app_js_start[]        asm("_binary_app_js_start");
extern const uint8_t app_js_end[]          asm("_binary_app_js_end");

#define MAX_POST_BODY 512

static esp_err_t read_body(httpd_req_t *req, char *buf, size_t buf_len)
{
    int total = req->content_len;
    if (total <= 0 || total >= (int)buf_len) {
        buf[0] = '\0';
        return ESP_OK;
    }
    int received = httpd_req_recv(req, buf, total);
    if (received <= 0) return ESP_FAIL;
    buf[received] = '\0';
    return ESP_OK;
}

/* GET / */
static esp_err_t handler_get_ui(httpd_req_t *req)
{
    httpd_resp_set_type(req, "text/html");
    httpd_resp_send(req, (const char *)index_html_start,
                    index_html_end - index_html_start - 1);
    return ESP_OK;
}

/* GET /static/... — serves all embedded static files */
typedef struct {
    const char    *path;
    const char    *content_type;
    const uint8_t *start;
    const uint8_t *end;
    bool           cacheable;
} static_file_t;

static const static_file_t s_static_files[] = {
    {"/static/bootstrap/bootstrap.min.css", "text/css",               bootstrap_css_start, bootstrap_css_end, true},
    {"/static/bootstrap/bootstrap.min.js",  "application/javascript", bootstrap_js_start,  bootstrap_js_end,  true},
    {"/static/app.js",                      "application/javascript", app_js_start,        app_js_end,        false},
};
#define STATIC_FILES_COUNT (sizeof(s_static_files) / sizeof(s_static_files[0]))

static esp_err_t handler_get_static(httpd_req_t *req)
{
    for (size_t i = 0; i < STATIC_FILES_COUNT; i++) {
        if (strcmp(req->uri, s_static_files[i].path) == 0) {
            httpd_resp_set_type(req, s_static_files[i].content_type);
            if (s_static_files[i].cacheable) {
                httpd_resp_set_hdr(req, "Cache-Control", "max-age=86400");
            } else {
                httpd_resp_set_hdr(req, "Cache-Control", "no-cache");
            }
            /* TEXT-mode binary data appends a null byte — exclude it */
            httpd_resp_send(req, (const char *)s_static_files[i].start,
                            s_static_files[i].end - s_static_files[i].start - 1);
            return ESP_OK;
        }
    }
    httpd_resp_send_404(req);
    return ESP_FAIL;
}

/* GET /api/v1/relays */
static esp_err_t handler_get_relays(httpd_req_t *req)
{
    uint8_t mask = relay_get_mask();
    cJSON *root = cJSON_CreateObject();
    cJSON *arr  = cJSON_AddArrayToObject(root, "relays");
    for (int i = 0; i < BOARD_RELAY_COUNT; i++) {
        cJSON_AddItemToArray(arr, cJSON_CreateNumber((mask >> i) & 1));
    }
    char *json = cJSON_PrintUnformatted(root);
    cJSON_Delete(root);
    if (!json) {
        httpd_resp_send_err(req, HTTPD_500_INTERNAL_SERVER_ERROR, "OOM");
        return ESP_FAIL;
    }
    httpd_resp_set_type(req, "application/json");
    httpd_resp_sendstr(req, json);
    free(json);
    return ESP_OK;
}

/* POST /api/v1/relays/<n> */
static esp_err_t handler_post_relay(httpd_req_t *req)
{
    char body[MAX_POST_BODY];
    if (read_body(req, body, sizeof(body)) != ESP_OK) {
        httpd_resp_send_err(req, HTTPD_400_BAD_REQUEST, "Bad body");
        return ESP_FAIL;
    }

    int relay_num = 0;
    sscanf(req->uri + strlen("/api/v1/relays/"), "%d", &relay_num);
    if (relay_num < 1 || relay_num > BOARD_RELAY_COUNT) {
        httpd_resp_send_err(req, HTTPD_400_BAD_REQUEST, "Invalid relay number");
        return ESP_FAIL;
    }

    cJSON *root = cJSON_Parse(body);
    if (!root) {
        httpd_resp_send_err(req, HTTPD_400_BAD_REQUEST, "Invalid JSON");
        return ESP_FAIL;
    }
    cJSON *state_j = cJSON_GetObjectItem(root, "state");
    bool state = state_j ? (cJSON_IsTrue(state_j) ||
                            (cJSON_IsNumber(state_j) && state_j->valuedouble != 0)) : false;
    cJSON_Delete(root);

    esp_err_t ret = relay_set(relay_num, state);
    if (ret != ESP_OK) {
        httpd_resp_send_err(req, HTTPD_500_INTERNAL_SERVER_ERROR, "Relay error");
        return ESP_FAIL;
    }

    cJSON *resp = cJSON_CreateObject();
    cJSON_AddNumberToObject(resp, "relay", relay_num);
    cJSON_AddNumberToObject(resp, "state", state ? 1 : 0);
    char *json = cJSON_PrintUnformatted(resp);
    cJSON_Delete(resp);
    if (!json) {
        httpd_resp_send_err(req, HTTPD_500_INTERNAL_SERVER_ERROR, "OOM");
        return ESP_FAIL;
    }
    httpd_resp_set_type(req, "application/json");
    httpd_resp_sendstr(req, json);
    free(json);
    return ESP_OK;
}

/* GET /api/v1/inputs */
static esp_err_t handler_get_inputs(httpd_req_t *req)
{
    bool states[BOARD_DI_COUNT];
    di_get_all(states);

    cJSON *root = cJSON_CreateObject();
    cJSON *arr  = cJSON_AddArrayToObject(root, "inputs");
    for (int i = 0; i < BOARD_DI_COUNT; i++) {
        cJSON_AddItemToArray(arr, cJSON_CreateNumber(states[i] ? 1 : 0));
    }
    char *json = cJSON_PrintUnformatted(root);
    cJSON_Delete(root);
    if (!json) {
        httpd_resp_send_err(req, HTTPD_500_INTERNAL_SERVER_ERROR, "OOM");
        return ESP_FAIL;
    }
    httpd_resp_set_type(req, "application/json");
    httpd_resp_sendstr(req, json);
    free(json);
    return ESP_OK;
}

/* GET /api/v1/network */
static esp_err_t handler_get_network(httpd_req_t *req)
{
    char wifi_ssid[33] = {0}, wifi_pass[65] = {0};
    nvs_config_get_wifi(wifi_ssid, sizeof(wifi_ssid), wifi_pass, sizeof(wifi_pass));

    bool eth_conn = false, wifi_conn = false;
    char eth_ip[16] = {0}, wifi_ip[16] = {0};
    if (xSemaphoreTake(g_state_mutex, pdMS_TO_TICKS(50)) == pdTRUE) {
        eth_conn  = g_state.eth_connected;
        wifi_conn = g_state.wifi_connected;
        memcpy(eth_ip,  g_state.eth_ip,  sizeof(eth_ip));
        memcpy(wifi_ip, g_state.wifi_ip, sizeof(wifi_ip));
        xSemaphoreGive(g_state_mutex);
    }

    cJSON *root = cJSON_CreateObject();
    cJSON_AddStringToObject(root, "wifi_ssid",      wifi_ssid);
    cJSON_AddBoolToObject(root,   "eth_connected",  eth_conn);
    cJSON_AddBoolToObject(root,   "wifi_connected", wifi_conn);
    cJSON_AddStringToObject(root, "eth_ip",         eth_ip);
    cJSON_AddStringToObject(root, "wifi_ip",        wifi_ip);

    char *json = cJSON_PrintUnformatted(root);
    cJSON_Delete(root);
    if (!json) {
        httpd_resp_send_err(req, HTTPD_500_INTERNAL_SERVER_ERROR, "OOM");
        return ESP_FAIL;
    }
    httpd_resp_set_type(req, "application/json");
    httpd_resp_sendstr(req, json);
    free(json);
    return ESP_OK;
}

/* POST /api/v1/network/wifi */
static esp_err_t handler_post_wifi(httpd_req_t *req)
{
    char body[MAX_POST_BODY];
    if (read_body(req, body, sizeof(body)) != ESP_OK) {
        httpd_resp_send_err(req, HTTPD_400_BAD_REQUEST, "Bad body");
        return ESP_FAIL;
    }
    cJSON *root = cJSON_Parse(body);
    if (!root) {
        httpd_resp_send_err(req, HTTPD_400_BAD_REQUEST, "Invalid JSON");
        return ESP_FAIL;
    }
    cJSON *ssid_j = cJSON_GetObjectItem(root, "ssid");
    cJSON *pass_j = cJSON_GetObjectItem(root, "password");
    if (!cJSON_IsString(ssid_j)) {
        cJSON_Delete(root);
        httpd_resp_send_err(req, HTTPD_400_BAD_REQUEST, "Missing ssid");
        return ESP_FAIL;
    }
    const char *ssid = ssid_j->valuestring;
    const char *pass = cJSON_IsString(pass_j) ? pass_j->valuestring : "";

    nvs_config_set_wifi(ssid, pass);
    wifi_manager_connect(ssid, pass);
    cJSON_Delete(root);

    httpd_resp_set_type(req, "application/json");
    httpd_resp_sendstr(req, "{\"ok\":true}");
    return ESP_OK;
}

/* GET /api/v1/webhooks */
static esp_err_t handler_get_webhooks(httpd_req_t *req)
{
    static const char *trig_names[] = {"rising", "falling", "change"};

    cJSON *root = cJSON_CreateObject();
    cJSON *arr  = cJSON_AddArrayToObject(root, "webhooks");
    for (int i = 0; i < BOARD_DI_COUNT; i++) {
        char    url[256] = {0};
        uint8_t trig     = NVS_WEBHOOK_TRIG_RISING;
        uint8_t enabled  = 1;
        nvs_config_get_webhook(i, url, sizeof(url), &trig);
        nvs_config_get_webhook_enabled(i, &enabled);
        if (trig > 2) trig = 0;

        cJSON *wh = cJSON_CreateObject();
        cJSON_AddNumberToObject(wh, "input",   i + 1);
        cJSON_AddStringToObject(wh, "url",     url);
        cJSON_AddStringToObject(wh, "trigger", trig_names[trig]);
        cJSON_AddBoolToObject(wh,   "enabled", enabled != 0);
        cJSON_AddItemToArray(arr, wh);
    }
    char *json = cJSON_PrintUnformatted(root);
    cJSON_Delete(root);
    if (!json) {
        httpd_resp_send_err(req, HTTPD_500_INTERNAL_SERVER_ERROR, "OOM");
        return ESP_FAIL;
    }
    httpd_resp_set_type(req, "application/json");
    httpd_resp_sendstr(req, json);
    free(json);
    return ESP_OK;
}

/* POST /api/v1/webhooks/<n> */
static esp_err_t handler_post_webhook(httpd_req_t *req)
{
    char body[MAX_POST_BODY];
    if (read_body(req, body, sizeof(body)) != ESP_OK) {
        httpd_resp_send_err(req, HTTPD_400_BAD_REQUEST, "Bad body");
        return ESP_FAIL;
    }

    int input_num = 0;
    sscanf(req->uri + strlen("/api/v1/webhooks/"), "%d", &input_num);
    if (input_num < 1 || input_num > BOARD_DI_COUNT) {
        httpd_resp_send_err(req, HTTPD_400_BAD_REQUEST, "Invalid input number");
        return ESP_FAIL;
    }

    cJSON *root = cJSON_Parse(body);
    if (!root) {
        httpd_resp_send_err(req, HTTPD_400_BAD_REQUEST, "Invalid JSON");
        return ESP_FAIL;
    }
    cJSON *url_j     = cJSON_GetObjectItem(root, "url");
    cJSON *trig_j    = cJSON_GetObjectItem(root, "trigger");
    cJSON *enabled_j = cJSON_GetObjectItem(root, "enabled");
    const char *url  = cJSON_IsString(url_j)  ? url_j->valuestring  : "";
    const char *trig = cJSON_IsString(trig_j) ? trig_j->valuestring : "rising";

    uint8_t trig_val = NVS_WEBHOOK_TRIG_RISING;
    if (strcmp(trig, "falling") == 0)     trig_val = NVS_WEBHOOK_TRIG_FALLING;
    else if (strcmp(trig, "change") == 0) trig_val = NVS_WEBHOOK_TRIG_CHANGE;

    nvs_config_set_webhook(input_num - 1, url, trig_val);

    if (enabled_j != NULL) {
        uint8_t en = (cJSON_IsTrue(enabled_j) ||
                      (cJSON_IsNumber(enabled_j) && enabled_j->valuedouble != 0)) ? 1 : 0;
        nvs_config_set_webhook_enabled(input_num - 1, en);
    }
    cJSON_Delete(root);

    httpd_resp_set_type(req, "application/json");
    httpd_resp_sendstr(req, "{\"ok\":true}");
    return ESP_OK;
}

/* GET /api/v1/input_modes */
static esp_err_t handler_get_input_modes(httpd_req_t *req)
{
    cJSON *root = cJSON_CreateObject();
    cJSON *arr  = cJSON_AddArrayToObject(root, "modes");
    for (int i = 0; i < BOARD_DI_COUNT; i++) {
        uint8_t mode       = NVS_INPUT_MODE_OFF;
        uint8_t relay_mask = (uint8_t)(1 << i);
        nvs_config_get_input_mode(i, &mode);
        nvs_config_get_relay_target(i, &relay_mask);
        cJSON *m = cJSON_CreateObject();
        cJSON_AddNumberToObject(m, "mode",       mode);
        cJSON_AddNumberToObject(m, "relay_mask", relay_mask);
        cJSON_AddItemToArray(arr, m);
    }
    char *json = cJSON_PrintUnformatted(root);
    cJSON_Delete(root);
    if (!json) {
        httpd_resp_send_err(req, HTTPD_500_INTERNAL_SERVER_ERROR, "OOM");
        return ESP_FAIL;
    }
    httpd_resp_set_type(req, "application/json");
    httpd_resp_sendstr(req, json);
    free(json);
    return ESP_OK;
}

/* POST /api/v1/input_modes/<n> */
static esp_err_t handler_post_input_mode(httpd_req_t *req)
{
    char body[MAX_POST_BODY];
    if (read_body(req, body, sizeof(body)) != ESP_OK) {
        httpd_resp_send_err(req, HTTPD_400_BAD_REQUEST, "Bad body");
        return ESP_FAIL;
    }

    int input_num = 0;
    sscanf(req->uri + strlen("/api/v1/input_modes/"), "%d", &input_num);
    if (input_num < 1 || input_num > BOARD_DI_COUNT) {
        httpd_resp_send_err(req, HTTPD_400_BAD_REQUEST, "Invalid input number");
        return ESP_FAIL;
    }

    cJSON *root = cJSON_Parse(body);
    if (!root) {
        httpd_resp_send_err(req, HTTPD_400_BAD_REQUEST, "Invalid JSON");
        return ESP_FAIL;
    }
    cJSON *mode_j  = cJSON_GetObjectItem(root, "mode");
    cJSON *rmask_j = cJSON_GetObjectItem(root, "relay_mask");

    uint8_t mode = NVS_INPUT_MODE_OFF;
    if (cJSON_IsNumber(mode_j)) {
        int v = (int)mode_j->valuedouble;
        if (v >= 0 && v <= 2) mode = (uint8_t)v;
    }
    nvs_config_set_input_mode(input_num - 1, mode);

    if (cJSON_IsNumber(rmask_j)) {
        uint8_t mask = (uint8_t)((int)rmask_j->valuedouble & 0xFF);
        nvs_config_set_relay_target(input_num - 1, mask);
    }
    cJSON_Delete(root);

    httpd_resp_set_type(req, "application/json");
    httpd_resp_sendstr(req, "{\"ok\":true}");
    return ESP_OK;
}

/* GET /api/v1/ntp */
static esp_err_t handler_get_ntp(httpd_req_t *req)
{
    char server[64] = "pool.ntp.org";
    char tz[64]     = "UTC0";
    nvs_config_get_ntp(server, sizeof(server), tz, sizeof(tz));

    time_t now = 0;
    time(&now);
    struct tm t;
    localtime_r(&now, &t);
    char timebuf[32];
    strftime(timebuf, sizeof(timebuf), "%Y-%m-%dT%H:%M:%S", &t);

    cJSON *root = cJSON_CreateObject();
    cJSON_AddStringToObject(root, "server", server);
    cJSON_AddStringToObject(root, "tz",     tz);
    cJSON_AddStringToObject(root, "time",   timebuf);
    cJSON_AddBoolToObject(root,   "synced", now > 1000000000);
    char *json = cJSON_PrintUnformatted(root);
    cJSON_Delete(root);
    if (!json) {
        httpd_resp_send_err(req, HTTPD_500_INTERNAL_SERVER_ERROR, "OOM");
        return ESP_FAIL;
    }
    httpd_resp_set_type(req, "application/json");
    httpd_resp_sendstr(req, json);
    free(json);
    return ESP_OK;
}

/* POST /api/v1/ntp */
static esp_err_t handler_post_ntp(httpd_req_t *req)
{
    char body[MAX_POST_BODY];
    if (read_body(req, body, sizeof(body)) != ESP_OK) {
        httpd_resp_send_err(req, HTTPD_400_BAD_REQUEST, "Bad body");
        return ESP_FAIL;
    }
    cJSON *root = cJSON_Parse(body);
    if (!root) {
        httpd_resp_send_err(req, HTTPD_400_BAD_REQUEST, "Invalid JSON");
        return ESP_FAIL;
    }
    cJSON *srv_j = cJSON_GetObjectItem(root, "server");
    cJSON *tz_j  = cJSON_GetObjectItem(root, "tz");
    const char *server = cJSON_IsString(srv_j) ? srv_j->valuestring : "pool.ntp.org";
    const char *tz     = cJSON_IsString(tz_j)  ? tz_j->valuestring  : "UTC0";

    nvs_config_set_ntp(server, tz);

    /* Apply timezone immediately */
    setenv("TZ", tz, 1);
    tzset();

    /* Restart SNTP with new server */
    esp_sntp_stop();
    esp_sntp_setservername(0, server);
    esp_sntp_init();

    cJSON_Delete(root);
    httpd_resp_set_type(req, "application/json");
    httpd_resp_sendstr(req, "{\"ok\":true}");
    return ESP_OK;
}

/* GET /api/v1/state — combined relay + input snapshot for fast polling */
static esp_err_t handler_get_state(httpd_req_t *req)
{
    uint8_t relay_mask = relay_get_mask();
    bool    inputs[BOARD_DI_COUNT];
    di_get_all(inputs);

    cJSON *root = cJSON_CreateObject();
    cJSON *rarr = cJSON_AddArrayToObject(root, "relays");
    for (int i = 0; i < BOARD_RELAY_COUNT; i++) {
        cJSON_AddItemToArray(rarr, cJSON_CreateNumber((relay_mask >> i) & 1));
    }
    cJSON *iarr = cJSON_AddArrayToObject(root, "inputs");
    for (int i = 0; i < BOARD_DI_COUNT; i++) {
        cJSON_AddItemToArray(iarr, cJSON_CreateNumber(inputs[i] ? 1 : 0));
    }
    char *json = cJSON_PrintUnformatted(root);
    cJSON_Delete(root);
    if (!json) {
        httpd_resp_send_err(req, HTTPD_500_INTERNAL_SERVER_ERROR, "OOM");
        return ESP_FAIL;
    }
    httpd_resp_set_type(req, "application/json");
    httpd_resp_set_hdr(req, "Cache-Control", "no-cache");
    httpd_resp_sendstr(req, json);
    free(json);
    return ESP_OK;
}

esp_err_t http_server_start(void)
{
    httpd_config_t config       = HTTPD_DEFAULT_CONFIG();
    config.max_uri_handlers     = 20;
    config.uri_match_fn         = httpd_uri_match_wildcard;
    config.lru_purge_enable     = true;
    config.recv_wait_timeout    = 30;
    config.send_wait_timeout    = 30;

    httpd_handle_t server = NULL;
    ESP_ERROR_CHECK(httpd_start(&server, &config));

    static const httpd_uri_t uris[] = {
        {.uri = "/",                        .method = HTTP_GET,  .handler = handler_get_ui},
        {.uri = "/static/*",               .method = HTTP_GET,  .handler = handler_get_static},
        {.uri = "/api/v1/relays",          .method = HTTP_GET,  .handler = handler_get_relays},
        {.uri = "/api/v1/relays/*",        .method = HTTP_POST, .handler = handler_post_relay},
        {.uri = "/api/v1/inputs",          .method = HTTP_GET,  .handler = handler_get_inputs},
        {.uri = "/api/v1/input_modes",     .method = HTTP_GET,  .handler = handler_get_input_modes},
        {.uri = "/api/v1/input_modes/*",   .method = HTTP_POST, .handler = handler_post_input_mode},
        {.uri = "/api/v1/network",         .method = HTTP_GET,  .handler = handler_get_network},
        {.uri = "/api/v1/network/wifi",    .method = HTTP_POST, .handler = handler_post_wifi},
        {.uri = "/api/v1/webhooks",        .method = HTTP_GET,  .handler = handler_get_webhooks},
        {.uri = "/api/v1/webhooks/*",      .method = HTTP_POST, .handler = handler_post_webhook},
        {.uri = "/api/v1/ntp",             .method = HTTP_GET,  .handler = handler_get_ntp},
        {.uri = "/api/v1/ntp",             .method = HTTP_POST, .handler = handler_post_ntp},
        {.uri = "/api/v1/state",           .method = HTTP_GET,  .handler = handler_get_state},
    };
    for (size_t i = 0; i < sizeof(uris) / sizeof(uris[0]); i++) {
        ESP_ERROR_CHECK(httpd_register_uri_handler(server, &uris[i]));
    }

    ESP_LOGI(TAG, "HTTP server started");
    return ESP_OK;
}
